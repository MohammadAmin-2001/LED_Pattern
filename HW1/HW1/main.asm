;
; HW1.asm
;
; Created: 9/29/2022 2:33:55 PM
; Author : mohammad amin geramimehr:98521441
;
; Replace with your application code
.INCLUDE "M32DEF.INC"

LDI R16 , HIGH(RAMEND)
OUT SPH , R16
LDI R16 , LOW(RAMEND)
OUT SPL ,R16

START:
	LDI R16 , 0XFF
	OUT DDRB , R16
	LDI R16 , 0X01
	
	LDI R17 , 0X00
	OUT DDRA , R17
	


LOOPL: 
	OUT PORTB , R16
	RCALL DELAY
	LSL R16 
	CPI R16 , 0X00
	BRNE LOOPL
	LDI R16 ,0B01000000
	RJMP LOOPR


LOOPR:
	OUT PORTB, R16
	CALL DELAY
	LSR R16
	CPI R16 ,0X00
	BRNE LOOPR
	LDI R16 ,0B00000010
	RJMP LOOPL

DELAY:
	IN R17 , PINA
	LDI R18 , 0X10
L1:	LDI R19 , 0XFF
L2: MOV R20 , R17
L3:
	DEC R20
	BRNE L3
	DEC R19
	BRNE L2
	DEC R18
	BRNE L1
	RET

	



	



	
